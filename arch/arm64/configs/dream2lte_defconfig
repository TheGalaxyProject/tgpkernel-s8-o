## arch/arm64/configs/dream2lte_defconfig
```kconfig
#
# Modifications for Samsung Galaxy S8+ (dream2lte)
#
# CONFIG_MODEL_DREAMLTE is not set
CONFIG_MODEL_DREAM2LTE=y
# CONFIG_CAMERA_DREAM is not set
CONFIG_CAMERA_DREAM2=y
# CONFIG_POC_DREAM is not set
CONFIG_POC_DREAM2=y
# CONFIG_SENSORS_HRM_MAX86902 is not set
CONFIG_SENSORS_HRM_ADPD143=y
# CONFIG_SENSORS_HRM_MAX869_ENHANCED_EOL is not set
```

## arch/arm64/configs/dreamlte_defconfig
```kconfig
#
# Modifications for Samsung Galaxy S8 (dreamlte)
#
CONFIG_MODEL_DREAMLTE=y
# CONFIG_MODEL_DREAM2LTE is not set
CONFIG_CAMERA_DREAM=y
# CONFIG_CAMERA_DREAM2 is not set
CONFIG_POC_DREAM=y
# CONFIG_POC_DREAM2 is not set
CONFIG_SENSORS_HRM_MAX86902=y
# CONFIG_SENSORS_HRM_ADPD143 is not set
CONFIG_SENSORS_HRM_MAX869_ENHANCED_EOL=y
```
